## arch/arm/mach-exynos/Kconfig
```kconfig
# SPDX-License-Identifier: GPL-2.0
#
# Copyright (c) 2010-2011 Samsung Electronics Co., Ltd.
#		http://www.samsung.com/

# Configuration options for the EXYNOS

menuconfig ARCH_EXYNOS
	bool "Samsung EXYNOS"
	depends on ARCH_MULTI_V7
	select ARCH_HAS_HOLES_MEMORYMODEL
	select ARCH_SUPPORTS_BIG_ENDIAN
	select ARM_AMBA
	select ARM_GIC
	select COMMON_CLK_SAMSUNG
	select EXYNOS_THERMAL
	select EXYNOS_PMU
	select EXYNOS_SROM
	select EXYNOS_PM_DOMAINS if PM_GENERIC_DOMAINS
	select GPIOLIB
	select HAVE_ARM_SCU if SMP
	select HAVE_S3C2410_I2C if I2C
	select HAVE_S3C2410_WATCHDOG if WATCHDOG
	select HAVE_S3C_RTC if RTC_CLASS
	select PINCTRL
	select PINCTRL_EXYNOS
	select PM_GENERIC_DOMAINS if PM
	select S5P_DEV_MFC
	select SAMSUNG_MC
	select SOC_SAMSUNG
	select SRAM
	select THERMAL
	select THERMAL_OF
	select MFD_SYSCON
	select MEMORY
	select CLKSRC_EXYNOS_MCT
	select POWER_RESET
	select POWER_RESET_SYSCON
	select POWER_RESET_SYSCON_POWEROFF
	help
	  Support for SAMSUNG EXYNOS SoCs (EXYNOS4/5)

if ARCH_EXYNOS

config ARCH_EXYNOS5
	bool "SAMSUNG EXYNOS5"
	select HAVE_ARM_SCU if SMP
	select HAVE_SMP
	select HAVE_EXYNOS5_HSI2C if I2C
	help
	  Samsung EXYNOS5 (Cortex-A15) SoC based systems

config MACH_UNIVERSAL5433
	bool "SAMSUNG UNIVERSAL5433 Machine using device tree"
	default y
	depends on ARCH_EXYNOS5 && SOC_EXYNOS5433
	select ARM_AMBA
	select CLKSRC_OF
	select PINCTRL
	select PINCTRL_EXYNOS
	select USE_OF
	select MIGHT_HAVE_PCI
	select PCI_DOMAINS if PCI
	help
	  Machine support for Samsung EXYNOS5433 machine with device tree enabled.
	  Select this if a fdt blob is available for the EXYNOS5433 SoC based board.

config S5P_DEV_MFC
	bool
	help
	  Compile in setup memory (init) code for MFC

config ARCH_EXYNOS3
	bool "SAMSUNG EXYNOS3"
	select ARM_CPU_SUSPEND if PM
	help
	  Samsung EXYNOS3 (Cortex-A7) SoC based systems

config ARCH_EXYNOS4
	bool "SAMSUNG EXYNOS4"
	default y
	select ARM_CPU_SUSPEND if PM_SLEEP
	select CLKSRC_SAMSUNG_PWM if CPU_EXYNOS4210
	select CPU_EXYNOS4210
	select GIC_NON_BANKED
	select MIGHT_HAVE_CACHE_L2X0
	help
	  Samsung EXYNOS4 (Cortex-A9) SoC based systems

config ARCH_EXYNOS5
	bool "SAMSUNG EXYNOS5"
	default y
	help
	  Samsung EXYNOS5 (Cortex-A15/A7) SoC based systems

comment "EXYNOS SoCs"

config SOC_EXYNOS3250
	bool "SAMSUNG EXYNOS3250"
	default y
	depends on ARCH_EXYNOS3

config CPU_EXYNOS4210
	bool "SAMSUNG EXYNOS4210"
	default y
	depends on ARCH_EXYNOS4

config SOC_EXYNOS4412
	bool "SAMSUNG EXYNOS4412"
	default y
	depends on ARCH_EXYNOS4

config SOC_EXYNOS5250
	bool "SAMSUNG EXYNOS5250"
	default y
	depends on ARCH_EXYNOS5

config SOC_EXYNOS5260
	bool "SAMSUNG EXYNOS5260"
	default y
	depends on ARCH_EXYNOS5

config SOC_EXYNOS5410
	bool "SAMSUNG EXYNOS5410"
	default y
	depends on ARCH_EXYNOS5

config SOC_EXYNOS5420
	bool "SAMSUNG EXYNOS5420"
	default y
	depends on ARCH_EXYNOS5

config SOC_EXYNOS5800
	bool "SAMSUNG EXYNOS5800"
	default y
	depends on SOC_EXYNOS5420

config EXYNOS5420_MCPM
	bool "Exynos5420 Multi-Cluster PM support"
	depends on MCPM && SOC_EXYNOS5420
	select ARM_CCI400_PORT_CTRL
	select ARM_CPU_SUSPEND
	help
	  This is needed to provide CPU and cluster power management
	  on Exynos5420 implementing big.LITTLE.

config EXYNOS_CPU_SUSPEND
	bool
	select ARM_CPU_SUSPEND
	default PM_SLEEP || ARM_EXYNOS_CPUIDLE

config SOC_EXYNOS5433
	bool "SAMSUNG EXYNOS5433"
	default n
	depends on ARCH_EXYNOS5
	select PM_GENERIC_DOMAINS if PM
	select S5P_PM if PM
	select S5P_SLEEP if SUSPEND
	select SAMSUNG_DMADEV
	select EXYNOS_HSI2C_RESET_DURING_DSTOP if CPU_IDLE
	select EXYNOS_SPI_RESET_DURING_DSTOP if CPU_IDLE
	select EXYNOS_PWM_RESET_DURING_DSTOP if CPU_IDLE
	select CAL_SYS_PWRDOWN
	select SECCOMP
	select PLAT_SAMSUNG
	select GPIO_SAMSUNG

	help
	  Enable EXYNOS5433 SoC support

config CAL_SYS_PWRDOWN
	bool

choice
	prompt "Revision Type"
	depends on SOC_EXYNOS5433
	help
	  This option selects cpu revision number.

config SOC_EXYNOS5433_REV_0
	bool "Rev 0.0"

config SOC_EXYNOS5433_REV_1
	bool "Rev 1.0"

endchoice

config EXYNOS5433_BTS
	bool "Bus traffic shaper support"
	default y
	depends on SOC_EXYNOS5433
	help
	  Enable BTS (Bus traffic shaper) support

endif

menuconfig EXYNOS_CORESIGHT
	bool "Enable Coresight of exynos"
	depends on ARCH_EXYNOS
	default n

config EXYNOS_CORESIGHT_PC_INFO
	bool "Show Porgram Counter information"
	depends on EXYNOS_CORESIGHT
	default y
	help
	  Show Program Counter information When kernel panic.

config PC_ITERATION
	int "Number of Program Coutner information"
	depends on EXYNOS_CORESIGHT_PC_INFO
	range 1 10
	default 5
	help
	  Print out Program Counter as iteration value.

config EXYNOS_CORESIGHT_MAINTAIN_DBG_REG
	bool "Save/Restore Debug Registers"
	depends on EXYNOS_CORESIGHT
	default n
	help
	  When core power is down, debug registers are not mainained data
	  and OS-lock is set. To maintain data, debug registers's data must
	  save in /restore from memory. If OS-lock is set, debugging to use
	  trace32 is impossible. So OS-lock must clear when core power is up.
	  This config must enable only using iTSP program.

config SAMSUNG_PRODUCT_SHIP
	bool "set up for product shipping"
	default n

config BOARD_GTS28WIFI
	bool "Samsung Tab S2 8.0 WIFI"
	default n
	
config BOARD_GTS28LTEXX
	bool "Samsung Tab S2 8.0 LTE"
	default n
	
config BOARD_GTS210WIFI
	bool "Samsung Tab S2 9.7 WIFI"
	default n

config BOARD_GTS210LTEXX
	bool "Samsung Tab S2 9.7 LTE"
	default n

config BOARD_TRELTEXX
	bool "Samsung Galaxy N4 LTE (N910C/H)"
	default n

config BOARD_TRHPLTEXX
	bool "Samsung Galaxy N4 LTE (N910U)"
	default n

config BOARD_TRELTESKT
	bool "Samsung Galaxy N4 LTE SKT (N910S/L/K)"
	default n

config BOARD_TBELTESKT
	bool "Samsung Galaxy N4 EDGE LTE SKT (N915S/L/K)"
	default n

config BOARD_TRE3CALTESKT
	bool "Samsung Galaxy N4 S-LTE SKT (N916S/L/K)"
	default n

choice
	prompt "Target Locale"
	default TARGET_LOCALE_EUR

config TARGET_LOCALE_EUR
	bool "Europe Open"

config TARGET_LOCALE_KOR
	bool "Kor"
endchoice

config EXYNOS5_DYNAMIC_CPU_HOTPLUG
	bool "Dynamic CPU Hotplug support"
	depends on CPU_FREQ
	help
		Enable Dynamic CPU Hotplug

config EXYNOS5_SETUP_MIPIPHY
	bool
	depends on (VIDEO_EXYNOS_FIMC_IS || DECON_MIPI_DSI)
	default y
	help
	  Compile in common setup code for MIPI-CSIS devices

config EXYNOS_CONTENT_PATH_PROTECTION
	bool "Exynos Content Path Protection"
	depends on (ARM_TRUSTZONE && ARCH_EXYNOS5)
	default y
	help
	  Enable content path protection of EXYNOS.

config EXYNOS5_DYNAMIC_CPU_HOTPLUG_SLEEP_PREPARE
        int "Activate number of cores when sleep"
        depends on EXYNOS5_DYNAMIC_CPU_HOTPLUG
        default 1
        help
          When gose to sleep, activate some cores for performace
          during sleep/wakeup sequence.
          This config set the number of activate cores.
          defaut value is "4" to activate all cores in cluster0.

config EXYNOS5433_CORE_FEEDBACK_CHECK_DISABLE
	bool "Disable checking core feedback"
	default n
	help
	  Disable checking core feedback

config EXYNOS5433_ASV_NEON_WORKAROUND
	bool "Increase voltage for ATL 900 / 800 / 700"
	default n
	help
	  Increase ATL voltage

config TIMA
	bool "Enable TIMA(Trustzone based Integrity Measurement Archtecture feature"
	default n

config TIMA_LKMAUTH
	bool "Enable LKM authentication by TIMA"
	help
	   TIMA authenticates loaded kernel modules. Disable it if you don't 
	   want TIMA enabled.

config TIMA_RKP
	bool "Enable RKP (Realtime Kernel Protection) TIMA feature"
	depends on TIMA
	default n

config RKP_DBLMAP_PROT
	bool "Page Double Mapping protection"
	depends on TIMA_RKP
	default n
	help
	  Prevents unauthorized cred modification.

config HYP_RKP
	bool "Enable Hypervisor RKP"
	depends on TIMA_RKP
	default n

config TIMA_RKP_30
	bool "Enable RKP (Realtime Kernel Protection) TIMA 3.0 feature"
	depends on TIMA_RKP
	default y
	help
		TIMA RKP 30 features, including kernel fault fixup and optimized tima_pg_is_protected

config KNOX_KAP
       bool "Enable KNOX KAP mode"
       default n
       help 
              Knox Active Protection mode

config TIMA_RKP_L1_TABLES
	bool
	depends on TIMA_RKP
	default y
	help
	  TIMA taking over management of L1 tables.

config TIMA_RKP_L2_TABLES
	bool "Enable TIMA RKP L2 Tables"
	depends on TIMA_RKP
	default n
	help
	  TIMA taking over management L2 tables too.

config TIMA_RKP_L2_GROUP
	bool
	depends on TIMA_RKP_L2_TABLES
	default n
	help
	  TIMA grouping page table writes

config TIMA_RKP_LAZY_MMU
	bool
	depends on TIMA_RKP_L2_TABLES
	default	y 
	help
	  TIMA lazy MMU for L2 pages

config TIMA_IOMMU_OPT
	bool "Enable TIMA IOMMU OPT"
	depends on TIMA_RKP_L2_TABLES
	default	n
	help
	  TIMA IOMMU optimization for L2 pages
	
config TIMA_KMAP_OPT
	bool "Enable TIMA KMAP OPT"
	depends on TIMA_RKP_L2_TABLES
	default	n
	help
	  TIMA KMAP optimization for L2 pages

config TIMA_DALVIKHEAP_OPT
	bool "Enable TIMA DALVIKHEAP OPT"
	depends on TIMA_RKP_L2_TABLES
	default	n 
	help
	  TIMA DALVIK HEAP optimization for L2 pages

config TIMA_RKP_DEBUG
	bool "Enable TIMA RKP Debug"
	depends on TIMA_RKP
	default n
	help
	  not workable in  K3G right now, no code ported in for this part.TIMA debug infrastructure.

config TIMA_RKP_KDATA_PROT
	bool "Protection for kernel data"
	depends on TIMA_RKP_30
	depends on TIMA_RKP_L2_TABLES
	default n
	help
		Detects double mapping of kernel data.

config TIMA_RKP_RO_CRED
	bool "Protection for cred structure"
	depends on TIMA_RKP_30
	depends on TIMA_RKP_L2_TABLES
	default n
	help
		Prevents unauthorized cred modification.

config TIMA_LKMAUTH_CODE_PROT
	bool "Support Kernel Module"
	depends on MODULES
	default n
	help
	  Support Kernel Module

config TIMA_TEST_INFRA
	tristate "Testing infrastructure for TIMA"
	default n
	help
	  Kernel bits of the TIMA test infrastructure	  
```

## drivers/soc/samsung/Kconfig
```kconfig
# SPDX-License-Identifier: GPL-2.0
#
# SAMSUNG SoC drivers
#
menuconfig SOC_SAMSUNG
	bool "Samsung SoC driver support" if COMPILE_TEST

if SOC_SAMSUNG

config EXYNOS_PMU
	bool "Exynos PMU controller driver" if COMPILE_TEST
	depends on ARCH_EXYNOS || ((ARM || ARM64) && COMPILE_TEST)
	select EXYNOS_PMU_ARM_DRIVERS if ARM && ARCH_EXYNOS

# There is no need to enable these drivers for ARMv8
config EXYNOS_PMU_ARM_DRIVERS
	bool "Exynos PMU ARMv7-specific driver extensions" if COMPILE_TEST
	depends on EXYNOS_PMU

config EXYNOS_PM_DOMAINS
	bool "Exynos PM domains" if COMPILE_TEST
	depends on PM_GENERIC_DOMAINS || COMPILE_TEST

config MACH_UNIVERSAL5433
	bool "SAMSUNG UNIVERSAL5433 Machine using device tree"
	default y
	depends on ARCH_EXYNOS5 && SOC_EXYNOS5433
	select ARM_AMBA
	select CLKSRC_OF
	select PINCTRL
	select PINCTRL_EXYNOS
	select USE_OF
	select MIGHT_HAVE_PCI
	select PCI_DOMAINS if PCI
	help
	  Machine support for Samsung EXYNOS5433 machine with device tree enabled.
	  Select this if a fdt blob is available for the EXYNOS5433 SoC based board.

endif
```

## drivers/thermal/samsung/Kconfig
```kconfig
config EXYNOS_THERMAL
	tristate "Exynos thermal management unit driver"
	depends on THERMAL_OF
	depends on HAS_IOMEM
	help
	  If you say yes here you get support for the TMU (Thermal Management
	  Unit) driver for SAMSUNG EXYNOS series of SoCs. This driver initialises
	  the TMU, reports temperature and handles cooling action if defined.
	  This driver uses the Exynos core thermal APIs and TMU configuration
	  data from the supported SoCs.
	  
config EXYNOS_SWTRIP
	bool "SW TRIP Feature on Samsung EXYNOS"
	depends on (ARCH_EXYNOS4 || ARCH_EXYNOS5)
	depends on EXYNOS_THERMAL
	help
	  Support for SWTRIP uevent on SAMSUNG EXYNOS series of SOC
```
